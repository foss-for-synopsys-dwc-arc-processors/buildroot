## configs/nsim_riscv64_defconfig
```kconfig
# Synopsys nSIM RISC-V 64-bit configuration
BR2_riscv=y
BR2_RISCV_64=y
BR2_RISCV_ABI_LP64D=y

# System configuration
BR2_ROOTFS_POST_IMAGE_SCRIPT="board/synopsys/nsim-riscv64/post-image.sh"

# Toolchain - use uClibc instead of glibc
BR2_TOOLCHAIN_BUILDROOT=y
BR2_TOOLCHAIN_BUILDROOT_UCLIBC=y
BR2_UCLIBC_VERSION_1_0_54=y

# Kernel headers
BR2_KERNEL_HEADERS_6_12=y

# Linux kernel
BR2_LINUX_KERNEL=y
BR2_LINUX_KERNEL_CUSTOM_VERSION=y
BR2_LINUX_KERNEL_CUSTOM_VERSION_VALUE="6.12.27"
BR2_LINUX_KERNEL_USE_ARCH_DEFAULT_CONFIG=y
BR2_LINUX_KERNEL_CONFIG_FRAGMENT_FILES="board/synopsys/nsim-riscv64/kernel-fragment.config"
BR2_LINUX_KERNEL_IMAGE=y

# Filesystem
BR2_TARGET_ROOTFS_EXT2=y
BR2_TARGET_ROOTFS_EXT2_SIZE="200M"
```

## package/binutils/Config.in.host
```kconfig
comment "Binutils Options"

config BR2_PACKAGE_HOST_BINUTILS_SUPPORTS_CFI
	bool
	default y
	depends on !BR2_microblaze

choice
	prompt "Binutils Version"
	default BR2_BINUTILS_VERSION_2_41_X if !BR2_arc
	default BR2_BINUTILS_VERSION_ARC_NEXT if BR2_arc
	help
	  Select the version of binutils you wish to use.

config BR2_BINUTILS_VERSION_2_40_X
	bool "binutils 2.40"

config BR2_BINUTILS_VERSION_2_41_X
	bool "binutils 2.41"

config BR2_BINUTILS_VERSION_ARC
	bool "binutils arc (2.42)"
	depends on BR2_arc

config BR2_BINUTILS_VERSION_ARC_NEXT
	bool "binutils arc (2.43) - next"
	depends on BR2_arc

config BR2_BINUTILS_VERSION_2_42_X
	bool "binutils 2.42"

endchoice

config BR2_BINUTILS_VERSION
	string
	default "arc-2024.06-release"	if BR2_BINUTILS_VERSION_ARC
	default "arc-2024.12"	if BR2_BINUTILS_VERSION_ARC_NEXT
	default "2.40"		if BR2_BINUTILS_VERSION_2_40_X
	default "2.41"		if BR2_BINUTILS_VERSION_2_41_X
	default "2.42"		if BR2_BINUTILS_VERSION_2_42_X

config BR2_BINUTILS_GPROFNG
	bool "gprofng support"
	depends on !BR2_BINUTILS_VERSION_ARC
	help
	  This option enables support for gprofng, a new profiler.

config BR2_BINUTILS_EXTRA_CONFIG_OPTIONS
	string "Additional binutils options"
	default ""
	help
	  Any additional binutils options you may want to include.
```
