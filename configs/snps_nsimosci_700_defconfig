## configs/snps_nsimosci_700_defconfig
```kconfig
BR2_arcle=y
BR2_arc700d=y
BR2_KERNEL_HEADERS_4_6=y
BR2_TOOLCHAIN_BUILDROOT_INET_RPC=y
BR2_PTHREAD_DEBUG=y
BR2_ROOTFS_OVERLAY="board/synopsys/nsimosci/fs-overlay"
BR2_LINUX_KERNEL=y
BR2_LINUX_KERNEL_DEFCONFIG="nsimosci"
BR2_LINUX_KERNEL_VMLINUX=y
BR2_TARGET_ROOTFS_INITRAMFS=y
```

## configs/snps_nsimosci_hs_defconfig
```kconfig
BR2_arcle=y
BR2_archs38=y
BR2_PTHREAD_DEBUG=y
BR2_ROOTFS_OVERLAY="board/synopsys/nsimosci/fs-overlay"

BR2_LINUX_KERNEL=y
BR2_LINUX_KERNEL_LATEST_VERSION=y
BR2_LINUX_KERNEL_VERSION="4.6.1"
BR2_LINUX_KERNEL_PATCH=""
BR2_LINUX_KERNEL_USE_DEFCONFIG=y
BR2_LINUX_KERNEL_DEFCONFIG="nsimosci_hs"
BR2_LINUX_KERNEL_CONFIG_FRAGMENT_FILES=""
BR2_LINUX_KERNEL_VMLINUX=y

#BR2_LINUX_KERNEL=y
#BR2_LINUX_KERNEL_CUSTOM_GIT=y
#BR2_LINUX_KERNEL_CUSTOM_REPO_URL="https://github.com/foss-for-synopsys-dwc-arc-processors/linux"
#BR2_LINUX_KERNEL_CUSTOM_REPO_VERSION="arc-3.18"
#BR2_LINUX_KERNEL_DEFCONFIG="nsimosci_hs"
#BR2_LINUX_KERNEL_VMLINUX=y

BR2_TARGET_ROOTFS_INITRAMFS=y

#
# Toolchain
#
BR2_TOOLCHAIN=y
BR2_TOOLCHAIN_USES_UCLIBC=y
BR2_TOOLCHAIN_EXTERNAL=y
BR2_TOOLCHAIN_EXTERNAL_CUSTOM=y
BR2_TOOLCHAIN_EXTERNAL_PREINSTALLED=y
BR2_TOOLCHAIN_EXTERNAL_PATH="$(INSTALL_DIR)"
BR2_TOOLCHAIN_EXTERNAL_CUSTOM_PREFIX="$(ARCH)-snps-linux-uclibc"
BR2_TOOLCHAIN_EXTERNAL_PREFIX="$(ARCH)-snps-linux-uclibc"
BR2_TOOLCHAIN_EXTERNAL_UCLIBC=y
BR2_TOOLCHAIN_EXTERNAL_GCC_4_8=y
BR2_TOOLCHAIN_EXTERNAL_HEADERS_4_6=y
BR2_TOOLCHAIN_EXTERNAL_CUSTOM_UCLIBC=y
BR2_TOOLCHAIN_EXTERNAL_WCHAR=y
BR2_TOOLCHAIN_EXTERNAL_LOCALE=y
BR2_TOOLCHAIN_EXTERNAL_HAS_THREADS=y
BR2_TOOLCHAIN_EXTERNAL_HAS_THREADS_DEBUG=y
BR2_TOOLCHAIN_EXTERNAL_HAS_THREADS_NPTL=y
BR2_TOOLCHAIN_EXTERNAL_HAS_SSP=y
BR2_TOOLCHAIN_EXTERNAL_INET_RPC=y
BR2_TOOLCHAIN_EXTERNAL_CXX=y
BR2_TOOLCHAIN_EXTRA_EXTERNAL_LIBS=""
BR2_TOOLCHAIN_HAS_NATIVE_RPC=y
BR2_USE_WCHAR=y
BR2_ENABLE_LOCALE=y
BR2_INSTALL_LIBSTDCPP=y
BR2_TOOLCHAIN_HAS_THREADS=y
BR2_TOOLCHAIN_HAS_THREADS_DEBUG=y
BR2_TOOLCHAIN_HAS_THREADS_NPTL=y
BR2_TOOLCHAIN_HAS_SHADOW_PASSWORDS=y
BR2_TOOLCHAIN_HAS_SSP=y
R2_NEEDS_GETTEXT=y
BR2_NEEDS_GETTEXT_IF_LOCALE=y
BR2_USE_MMU=y
BR2_TOOLCHAIN_HAS_LIBATOMIC=y
BR2_TOOLCHAIN_HAS_ATOMIC=y
BR2_TOOLCHAIN_HEADERS_AT_LEAST="4.6"
```

## configs/xplorer_defconfig
```kconfig
BR2_arcle=y
BR2_JLEVEL=5
BR2_TOOLCHAIN_BUILDROOT_LARGEFILE=y
BR2_TOOLCHAIN_BUILDROOT_INET_IPV6=y
BR2_TOOLCHAIN_BUILDROOT_INET_RPC=y
BR2_TOOLCHAIN_BUILDROOT_LOCALE=y
BR2_PTHREAD_DEBUG=y
BR2_PACKAGE_HOST_GDB=y
BR2_TOOLCHAIN_BUILDROOT_CXX=y
BR2_ROOTFS_DEVICE_CREATION_DYNAMIC_MDEV=y
BR2_TARGET_GENERIC_GETTY_PORT="ttyS3"
BR2_LINUX_KERNEL=y
BR2_LINUX_KERNEL_CUSTOM_GIT=y
BR2_LINUX_KERNEL_CUSTOM_GIT_REPO_URL="https://github.com/foss-for-synopsys-dwc-arc-processors/linux.git"
BR2_LINUX_KERNEL_CUSTOM_GIT_VERSION="arc-3.11"
BR2_LINUX_KERNEL_DEFCONFIG="xplorer_system_770"
BR2_LINUX_KERNEL_DTS_SUPPORT=y
BR2_LINUX_KERNEL_INTREE_DTS_NAME="xplorer_system_770"
BR2_PACKAGE_BUSYBOX_CONFIG="configs/xplorer_busybox_config"
BR2_PACKAGE_GDB=y
BR2_PACKAGE_PERF=y
BR2_PACKAGE_I2C_TOOLS=y
BR2_PACKAGE_USBUTILS=y
BR2_PACKAGE_LZO=y
BR2_PACKAGE_ZLIB=y
BR2_PACKAGE_LIBUSB_COMPAT=y
BR2_TARGET_ROOTFS_CPIO_LZO=y
BR2_TARGET_ROOTFS_INITRAMFS=y
# BR2_TARGET_ROOTFS_TAR is not set
```

## package/busybox/Config.in
```kconfig
config BR2_PACKAGE_BUSYBOX
	bool "BusyBox"
	default y
	help
	  The Swiss Army Knife of embedded Linux. It slices, it dices, it
	  makes Julian Fries.

	  http://busybox.net/

	  Most people will answer Y.

if BR2_PACKAGE_BUSYBOX

config BR2_PACKAGE_BUSYBOX_CONFIG
	string "BusyBox configuration file to use?"
	default "package/busybox/busybox.config"
	help
	  Some people may wish to use their own modified BusyBox configuration
	  file, and will specify their config file location with this option.

	  Most people will just use the default BusyBox configuration file.

config BR2_PACKAGE_BUSYBOX_SHOW_OTHERS
	bool "Show packages that are also provided by busybox"
	help
	  Show packages in menuconfig that are potentially also provided
	  by busybox.

config BR2_PACKAGE_BUSYBOX_WATCHDOG
	bool "Install the watchdog daemon startup script"
	help
	  Install the watchdog daemon startup script,
	  that just start at the boot the busybox watchdog daemon.

if BR2_PACKAGE_BUSYBOX_WATCHDOG

config BR2_PACKAGE_BUSYBOX_WATCHDOG_PERIOD
	string "Delay between reset"
	default "5"
	help
	  Select the number of seconds between each
	  reset of the watchdog (default 5)

	  Use ms suffix to specify milliseconds (e.g. 500ms)

endif

config BR2_PACKAGE_BUSYBOX_STANDALONE_TELNETD
	bool "Enable telnet daemon on target"
	depends on !BR2_PACKAGE_XINETD
	default n
	help
	  By default user may interact with target via serial port if set in
	  kernel's command line with "console" option or as a GENERIC_GETTY here
	  in Buildroot.

	  Another useful option if target is connected to the network is telnet.

	  For it to work telnet daemon (telnetd) must be installed and
	  auto-started on target during boot process.

	  Say yes here if you would like to have an ability to telnet on target.
	  If unsure, say N.

	  WARNING! WARNING!
	  Telnet connection (especially if there're users with no password)
	  might be not safe, so on production systems please consider usage of
	  SSH (provided by Dropbear or OpenSSH packages).

endif

if !BR2_PACKAGE_BUSYBOX # kconfig doesn't support else

# add dummy config so the stuff with busybox alternatives are shown
# when busybox is disabled
config BR2_PACKAGE_BUSYBOX_SHOW_OTHERS
	default y
endif
```

## package/eembc_multibench/Config.in
```kconfig
config BR2_PACKAGE_EEMBC_MULTIBENCH
        bool "eembc_multibench"
        help
          https://gitsnps.internal.synopsys.com/arc_oss/eembc_multibench
```
